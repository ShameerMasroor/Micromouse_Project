## build/Kconfig/arch/Kconfig
```kconfig
# Load arch Kconfig descriptions.
osource "/home/root1/zephyrproject/zephyr/arch/x86/Kconfig"
osource "/home/root1/zephyrproject/zephyr/arch/xtensa/Kconfig"
osource "/home/root1/zephyrproject/zephyr/arch/sparc/Kconfig"
osource "/home/root1/zephyrproject/zephyr/arch/riscv/Kconfig"
osource "/home/root1/zephyrproject/zephyr/arch/posix/Kconfig"
osource "/home/root1/zephyrproject/zephyr/arch/nios2/Kconfig"
osource "/home/root1/zephyrproject/zephyr/arch/mips/Kconfig"
osource "/home/root1/zephyrproject/zephyr/arch/arm64/Kconfig"
osource "/home/root1/zephyrproject/zephyr/arch/arm/Kconfig"
osource "/home/root1/zephyrproject/zephyr/arch/arc/Kconfig"
```
