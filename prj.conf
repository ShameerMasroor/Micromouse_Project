## CMakeLists.txt
```
cmake_minimum_required(VERSION 3.20.0)
set(BOARD stm32f3_disco)

find_package(Zephyr REQUIRED HINTS $ENV{ZEPHYR_BASE})
project(Micromouse_Project)

# Add this line to include the header files in the 'include' directory
include_directories(${PROJECT_SOURCE_DIR}/../include)

target_sources(app PRIVATE src/control.c)
target_sources(app PRIVATE src/sensing.c)
target_sources(app PRIVATE src/IR.c)
target_sources(app PRIVATE src/algo.c)
target_sources(app PRIVATE src/motor.c)
target_sources(app PRIVATE src/encoders.c)
# # target_sources(app PRIVATE src/gyro.c)
target_sources(app PRIVATE src/accelerometer.c)
# target_sources(app PRIVATE src/analogIR.c)
```

## prj.conf
```kconfig
CONFIG_STDOUT_CONSOLE=y
CONFIG_PRINTK=y
CONFIG_PWM=y
CONFIG_LOG=y
CONFIG_LOG_PRINTK=y
CONFIG_LOG_MODE_IMMEDIATE=y
CONFIG_PWM_LOG_LEVEL_DBG=y
CONFIG_GPIO=y
CONFIG_CLOCK_CONTROL=y
CONFIG_PRINTK=y
CONFIG_HEAP_MEM_POOL_SIZE=256
CONFIG_ASSERT=y
CONFIG_UART_CONSOLE=y
CONFIG_SERIAL=y
CONFIG_UART_INTERRUPT_DRIVEN=y
CONFIG_NEWLIB_LIBC_FLOAT_PRINTF=y
CONFIG_NEWLIB_LIBC=y
# CONFIG_UART_CONSOLE_ON_DEV_NAME="UART_1"  # Replace with your UART device label
# CONFIG_UART_1_BAUD_RATE=115200  # Adjust baud rate as needed
# CONFIG_USART=y
# CONFIG_USART_1_BAUD_RATE=115200
CONFIG_SPI=y
CONFIG_SENSOR=y
# CONFIG_ADC =y
CONFIG_ADC_STM32=y
```

## src/main.c
```c
// // /*
// //  * Copyright (c) 2016 Intel Corporation
// //  *
// //  * SPDX-License-Identifier: Apache-2.0
// //  */

// // #include <stdio.h>
// // #include <zephyr/kernel.h>
// // #include <zephyr/drivers/gpio.h>

// // /* 1000 msec = 1 sec */
// // #define SLEEP_TIME_MS   1000

// // /* The devicetree node identifier for the "led0" alias. */
// // #define LED0_NODE DT_ALIAS(led3)
// // // #define LED2_NODE DT_ALIAS(&led2)

// // /*
// //  * A build error on this line means your boardprintf("Hello World! %s\n", CONFIG_BOARD_TARGET);
// //  is unsupported.
// //  * See the sample documentation for information on how to fix this.
// //  */
// // static const struct gpio_dt_spec led = GPIO_DT_SPEC_GET(LED0_NODE, gpios);
// // // static const struct gpio_dt_spec led = GPIO_DT_SPEC_GET(LED2_NODE, gpios);

// // int main(void)
// // {
// // 	int ret;
// // 	bool led_state = true;

// // 	if (!gpio_is_ready_dt(&led)) {
// // 		return 0;
// // 	}

// // 	ret = gpio_pin_configure_dt(&led, GPIO_OUTPUT_ACTIVE);
// // 	if (ret < 0) {
// // 		return 0;
// // 	}

// // 	while (1) {
// // 		ret = gpio_pin_toggle_dt(&led);
// // 		if (ret < 0) {
// // 			return 0;
// // 		}

// // 		led_state = !led_state;
// // 		printf("LED state: %s\n", led_state ? "ON" : "OFF");
// // 		k_msleep(SLEEP_TIME_MS);
// // 	}

// // 	//for testing the UART STLINK system on the board. By default, Zephyr uses UART 0
// // 	printf("LED Blinking %s\n", CONFIG_BOARD_TARGET);

// // 	return 0;
// // }


// /* 
// Now we shall try to control the behavior of the LEDs
// via threads. Good luck to us!
 
// */

// //Thread implementation code

// // #include <zephyr/kernel.h>
// // #include <zephyr/device.h>
// // #include <zephyr/drivers/gpio.h>
// // #include <zephyr/sys/printk.h>
// // #include <zephyr/sys/__assert.h>
// // #include <string.h>

// // /* size of stack area used by each thread */
// // #define STACKSIZE 2048

// // /* scheduling priority used by each thread */
// // #define PRIORITY 7

// // #define LED0_NODE DT_ALIAS(led0)
// // #define LED1_NODE DT_ALIAS(led1)
// // #define LED2_NODE DT_ALIAS(led2)

// // #if !DT_NODE_HAS_STATUS(LED0_NODE, okay)
// // #error "Unsupported board: led0 devicetree alias is not defined"
// // #endif

// // #if !DT_NODE_HAS_STATUS(LED1_NODE, okay)
// // #error "Unsupported board: led1 devicetree alias is not defined"
// // #endif

// // #if !DT_NODE_HAS_STATUS(LED2_NODE, okay)
// // #error "Unsupported board: led1 devicetree alias is not defined"
// // #endif



// // struct led {
// // 	struct gpio_dt_spec spec;
// // 	uint8_t num;
// // };

// // static const struct led led0 = {
// // 	.spec = GPIO_DT_SPEC_GET_OR(LED0_NODE, gpios, {0}),
// // 	.num = 0,
// // };

// // static const struct led led1 = {
// // 	.spec = GPIO_DT_SPEC_GET_OR(LED1_NODE, gpios, {0}),
// // 	.num = 1,
// // };

// // static const struct led led2 = {
// // 	.spec = GPIO_DT_SPEC_GET_OR(LED2_NODE, gpios, {0}),
// // 	.num = 2,
// // };

// // void blink(const struct led *led, uint32_t sleep_ms, uint32_t id)
// // {
// // 	const struct gpio_dt_spec *spec = &led->spec;
// // 	int cnt = 0;
// // 	int ret;

	

// // 	ret = gpio_pin_configure_dt(spec, GPIO_OUTPUT);
	

// // 	while (1) {
// // 		gpio_pin_set(spec->port, spec->pin, cnt % 2); //0 when 2 doesnt divide into cnt, 1 when 2 is a divisor

// // 		k_msleep(sleep_ms);
// // 		cnt++;
// // 	}
// // }

// // void blink0(void)     //for led0
// // {
// // 	blink(&led0, 100, 0);
// // }

// // void blink1(void)    //for led1
// // {
// // 	blink(&led1, 1000, 1);
// // }

// // void blink2(void)    //for led1
// // {
// // 	blink(&led2, 500, 2);

// // }

// // // void blink_runner(void)
// // // {
// // // blink(&led0, 100, 0);
// // // blink(&led1, 1000, 1);
// // // blink(&led2, 500, 2);
// // // }

// // // void master(void)
// // // {
// // K_THREAD_DEFINE(blink0_id, STACKSIZE, blink0, NULL, NULL, NULL,
// // 		PRIORITY, 0, 0);
// // K_THREAD_DEFINE(blink1_id, STACKSIZE, blink1, NULL, NULL, NULL,
// // 		PRIORITY, 0, 0);
// // K_THREAD_DEFINE(blink2_id, STACKSIZE, blink2, NULL, NULL, NULL,
// // 		PRIORITY, 0, 0);
// // // }

// // K_THREAD_DEFINE(master_thread, STACKSIZE, master, NULL, NULL, NULL,
// // 		PRIORITY, 0, 0);

// //code for on-board button implementation
// //----------------------------------------------------------------------------------------------
// // #include <zephyr/kernel.h>
// // #include <zephyr/device.h>
// // #include <zephyr/drivers/gpio.h>
// // #include <zephyr/sys/printk.h>
// // #include <zephyr/sys/__assert.h>
// // #include <string.h>
// // #include <zephyr/drivers/uart.h> //be careful about the directory you choose!!!
// // #include <stdio.h>

// // /* size of stack area used by each thread */
// // #define STACKSIZE 2048

// // /* scheduling priority used by each thread */
// // #define PRIORITY 7

// // #define LED0_NODE DT_ALIAS(led0)
// // #define BTN0_NODE DT_ALIAS(sw0)
// // #define UART0_NODE DT_NODELABEL(usart1) 
// // // #define UART1_NODE DT_ALIAS(uart1)


// // #if !DT_NODE_HAS_STATUS(LED0_NODE, okay)
// // #error "Unsupported board: led0 devicetree alias is not defined"
// // #endif

// // #if !DT_NODE_HAS_STATUS(BTN0_NODE, okay)
// // #error "Unsupported board: led1 devicetree alias is not defined"
// // #endif


// // #if !DT_NODE_HAS_STATUS(UART0_NODE, okay)
// // #error "Unsupported board: uart0 devicetree alias is not defined"
// // #endif


// // struct led {
// // 	struct gpio_dt_spec spec;
// // 	uint8_t num;
// // };

// // struct button {
// // 	struct gpio_dt_spec btn_spec;
// // 	uint8_t btn_num;
// // };

// // static const struct led led0 = {
// // 	.spec = GPIO_DT_SPEC_GET_OR(LED0_NODE, gpios, {0}),
// // 	.num = 0,
// // };

// // static const struct button btn0 = {
// // 	.btn_spec = GPIO_DT_SPEC_GET_OR(BTN0_NODE, gpios, {0}),
// // 	.btn_num = 0,
// // };

// // static const struct device *uart_dev = DEVICE_DT_GET(UART0_NODE);

// // void uart_cb(const struct device *dev, struct uart_event *evt, void *user_data)
// // {
// //     switch (evt->type) {
// //     case UART_TX_DONE:
// //         printk("UART_TX_DONE\n");
// //         break;
// //     case UART_RX_RDY:
// //         printk("Received data: %s\n", evt->data.rx.buf);
// //         break;
// //     default:
// //         break;
// //     }
// // }

// // void blink(const struct button *btn, uint32_t btn_id, const struct led *led, uint32_t id)
// // {
// // 	const struct gpio_dt_spec *spec = &led->spec;
// // 	const struct gpio_dt_spec *btn_spec = &btn->btn_spec;
	
// // 	int ret_led;
// // 	int ret_btn;

	

// // 	ret_led = gpio_pin_configure_dt(spec, GPIO_OUTPUT);
// // 	ret_btn = gpio_pin_configure_dt(btn_spec, GPIO_INPUT);

// // 	while (1) {
// //     int input_state = gpio_pin_get(btn_spec->port, btn_spec->pin); // Read input pin state

// //     // Check if input is high (assuming high means active)
// //     if (input_state) {
// //         gpio_pin_set(spec->port, spec->pin, 1); // Turn on LED
// // 		printk("\nLED is on\n");
// //     } 

// // 	else {
// //         gpio_pin_set(spec->port, spec->pin, 0); // Turn off LED
// // 		printk("\nLED is off\n");
// //         printf("Hello World! %s\n", CONFIG_BOARD_TARGET);
// //     }
// // 	// k_msleep(100);
// // }
// // }

// // void blink0(void)     //for led0
// // {
// // 	blink(&btn0, 0, &led0,0);
// // }


// // K_THREAD_DEFINE(blink0_id, STACKSIZE, blink0, NULL, NULL, NULL,
// // 		PRIORITY, 0, 0);
// // // K_THREAD_DEFINE(blink1_id, STACKSIZE, blink1, NULL, NULL, NULL,
// // // 		PRIORITY, 0, 0);
// // // K_THREAD_DEFINE(blink2_id, STACKSIZE, blink2, NULL, NULL, NULL,
// // // 		PRIORITY, 0, 0);


//===================================================================================================
//====================================================================================================
//=====================================================================================================


// //code for UART implementation

// #include <zephyr/kernel.h>
// #include <zephyr/device.h>
// #include <zephyr/drivers/gpio.h>
// #include <zephyr/sys/printk.h>
// #include <zephyr/sys/__assert.h>
// #include <string.h>
// #include <zephyr/drivers/uart.h>
// #include <stdio.h>
// #include "../include/ultrasonic.h"
// #include <zephyr/sys/mutex.h>
// #include "../include/shared_mutex.h"  // Include the shared header file

// /* size of stack area used by each thread */
// #define STACKSIZE 2048

// /* scheduling priority used by each thread */
// #define PRIORITY 7

// #define LED0_NODE DT_ALIAS(led0)
// #define BTN0_NODE DT_ALIAS(sw0)
// #define UART0_NODE DT_NODELABEL(usart1)  // as in our device tree
// #define ULTRASONIC_TRIG DT_ALIAS(ultrasonictrig)
// #define ULTRASONIC_ECHO DT_ALIAS(ultrasonicecho)

// K_MUTEX_DEFINE(uart_mutex);  //mutex definition

// #if !DT_NODE_HAS_STATUS(LED0_NODE, okay)
// #error "Unsupported board: led0 devicetree alias is not defined"
// #endif

// #if !DT_NODE_HAS_STATUS(BTN0_NODE, okay)
// #error "Unsupported board: btn0 devicetree alias is not defined"
// #endif

// struct led {
//     struct gpio_dt_spec spec;
//     uint8_t num;
// };

// struct button {
//     struct gpio_dt_spec btn_spec;
//     uint8_t btn_num;
// };

// static const struct led led0 = {
//     .spec = GPIO_DT_SPEC_GET_OR(LED0_NODE, gpios, {0}),
//     .num = 0,
// };

// static const struct button btn0 = {
//     .btn_spec = GPIO_DT_SPEC_GET_OR(BTN0_NODE, gpios, {0}),
//     .btn_num = 0,
// };

// void blink(const struct button *btn, uint32_t btn_id, const struct led *led, uint32_t id) {
//     const struct gpio_dt_spec *spec = &led->spec;
//     const struct gpio_dt_spec *btn_spec = &btn->btn_spec;

//     int ret_led;
//     int ret_btn;

//     ret_led = gpio_pin_configure_dt(spec, GPIO_OUTPUT);
//     ret_btn = gpio_pin_configure_dt(btn_spec, GPIO_INPUT);

//     while (1) {
//         int input_state = gpio_pin_get(btn_spec->port, btn_spec->pin); // Read input pin state

//         // Lock the mutex before accessing UART
//         k_mutex_lock(&uart_mutex, K_FOREVER);

//         // Check if input is high (assuming high means active)
//         if (input_state) {
//             gpio_pin_set(spec->port, spec->pin, 1); // Turn on LED
//             printk("\nLED is on\n");
//         } else {
//             gpio_pin_set(spec->port, spec->pin, 0); // Turn off LED
//             printk("\nLED is off\n"); //lowest overhead - best to use
//             printf("Hello World!\n"); //contains formatting capabilities - highest overhead
//             uart_poll_out(uart_dev, 'H');  // Send a character over UART, one character at a time - blocking in nature
//         }

//         k_mutex_unlock(&uart_mutex);
//     }
// }


// void blink0(void)     //for led0
// {
//     blink(&btn0, 0, &led0, 0);
// }

// void init_uart(void)  //you do not need this. You made the thread work using simply uart callback too
// {
// 	uart_callback_set(uart_dev, uart_cb, NULL);
// }

// void distance(void) {
//     // while (1) {
//         // k_mutex_lock(&uart_mutex, K_FOREVER); // Lock the mutex before accessing UART
//         measure_distance(&ultrasonic);
//         // k_mutex_unlock(&uart_mutex); // Unlock the mutex after accessing UART

//         // k_sleep(K_SECONDS(1)); // Sleep for 1 second before measuring distance again
//     // }
// }

// int main(void){
    
    
//     // int k_mutex_init(&uart_mutex);



//     k_mutex_lock(&uart_mutex, K_FOREVER);
//     init_ultrasonic(&ultrasonic);

//     k_mutex_unlock(&uart_mutex);
//     return 0;
// }

// // K_THREAD_DEFINE(ultrasonic_id2, STACKSIZE, main, NULL, NULL, NULL, PRIORITY, 0, 0);
// K_THREAD_DEFINE(ultrasonic_id, STACKSIZE, distance, NULL, NULL, NULL, PRIORITY, 0, 0);
// // K_THREAD_DEFINE(uart_id, STACKSIZE, init_uart, NULL, NULL, NULL, PRIORITY, 0, 0);
// // K_THREAD_DEFINE(blink0_id, STACKSIZE, blink0, NULL, NULL, NULL, PRIORITY, 0, 0);
```

## include/IR.h
```c
#pragma once
#include <zephyr/drivers/gpio.h>
#include <zephyr/kernel.h>
#include <zephyr/sys/printk.h>
#include <stdbool.h>
#include <stdio.h>

// extern int16_t adc_value;

typedef struct
{
   const struct gpio_dt_spec d_out;
} ir;

typedef struct
{
   bool left_ir_data;
   bool right_ir_data;
   bool front_ir_data;
   bool back_ir_data;
   int16_t right_analog_data;
   int16_t front_analog_data;
} ir_data_t;

void init_IR(void);
ir_data_t read_IR(void);
static int read_adc(void);
static int read_adc_front(void);
static void configure_adc(void);
int16_t return_analog();
int16_t return_analog_front();
```

## include/accelerometer.h
```c
#ifndef ACCELEROMETER_H
#define ACCELEROMETER_H

#include <zephyr/kernel.h>
#include <zephyr/device.h>
#include <zephyr/drivers/sensor.h>
#include <stdio.h>
#include <zephyr/sys/util.h>
#include <math.h>
// typedef struct
// {
//     void;
// } accel_t;

// static int32_t initAccelerometer(const struct device *sensor,
// 			   enum sensor_channel channel);
// void readAccelerometer(accel_t accel);
// extern char command_dir;
// extern bool release_command=1;
void initIMU(void);
void set_direction(char dir);
double readIMU();
double direction_controller_right();
double direction_controller_left();
double return_ref_yaw();
void right_turn(void);
void left_turn(void);
int enable_returner();
bool return_go_forward();
void set_return_go_forward(bool setting);
#endif // ACCELEROMETER_H
```

## include/algo.h
```c
#ifndef ALGO_H
#define ALGO_H

#include "sensing.h"

#define RIGHT_HAND 1
#define FLOOD_FILL 2
#define A_STAR 3

#define SELECTED_ALGORITHM FLOOD_FILL

#if SELECTED_ALGORITHM == RIGHT_HAND
char right_hand_follower(sensor_data_t *received_data);
#endif

#if SELECTED_ALGORITHM == FLOOD_FILL

 

typedef struct
{
    int x;
    int y;
} point;

typedef struct{
    point North;
    point South;
    point East;
    point West;
} Neighbours;


char floodfill(sensor_data_t *received_data);
#endif

#if SELECTED_ALGORITHM == A_STAR
void a_star();
#endif

#endif

//=====================================================================================================
// typedef struct 
// {
//     int rows;
//     int cols;
//     int end_row;
//     int end_col;
//     int start_row;
//     int start_col;
//     // int maze_map[20][30][4];  // Assuming max maze size, 4 for direction walls
// } Maze;

// typedef struct 
// { // output direction
//     char forward;
//     char left;
//     char back;
//     char right;
//     //why not a single
// } Direction;

// void wallFollower(Maze*, char* path, sensor_data_t *sensor_data);
// void optimizePath(char* path, char* optimized_path);
```

## include/control.h
```c
#ifndef CONTROL_H
#define CONTROL_H
#include <zephyr/kernel.h>
#include <zephyr/device.h>
#include <zephyr/drivers/gpio.h>
#include <zephyr/sys/printk.h>
#include <zephyr/sys/__assert.h>
#include <stdio.h>
#include "algo.h"
#include "motor.h"
#include "uart.h"
#include "sensing.h"
#include "shared_mutex.h" 
#include "sensing_control_q.h"
#include <stdbool.h>

//#include "gyro.h"
//#include "accelerometer.h"
void control_thread(void);

#endif // CONTROL_H
```

## include/control_motor_q.h
```c
// shared_mutex.h
#ifndef SENSING_CONTROL_Q_H
#define SENSING_CONTROL_Q_H

#include <zephyr/kernel.h>

extern struct k_msgq control_motor_q;

#endif // SHARED_MUTEX_H
```

## include/encoders.h
```c
#include <zephyr/device.h>
#include <zephyr/drivers/gpio.h>
#include "IR.h"
extern struct k_timer read_speed_timer;


typedef struct
{
   uint32_t left_encoder_count;
   uint32_t right_encoder_count;
   uint32_t rotation_left_counter;
   uint32_t rotation_right_counter;
   const struct gpio_dt_spec left_encoder_pin;
   const struct gpio_dt_spec right_encoder_pin;
   
} encoders_t;


void init_encoders();
double speed_matcher_left();
double speed_matcher_right();
double general_speed_matcher();
void  ctrl_signal_generator(double *pwm_left, double *pwm_right);
void speed_detector();
int distance();

int return_left_enc_count();
int return_right_enc_count();
void set_controller(bool flag);
void turn_returner(char turn);
```

## include/gyro.h
```c
#ifndef GYRO_H
#define GYRO_H

#include <stdio.h>
#include <zephyr/kernel.h>
#include <zephyr/device.h>
#include <zephyr/drivers/sensor.h>

#define SAMPLING_INTERVAL_MS 10
#define DISPLAY_INTERVAL_MS 50

// typedef struct
// {
//     void;
// } gyro_t;


// void initGyroscope(gyro_t* gyro);
// void readGyroscope(gyro_t gyro);

static struct sensor_value fetch_and_display_gyro(const struct device *sensor);
void initGyro(void);


#endif // GYRO_H
```

## include/motor.h
```c
#pragma once
#include <zephyr/drivers/gpio.h>
#include <zephyr/kernel.h>
#include <zephyr/sys/printk.h>
#include <zephyr/drivers/pwm.h>
#include <stdio.h>
#include "accelerometer.h" 

extern struct k_msgq motor_control_q;

typedef struct {
    const struct gpio_dt_spec in1;
    const struct gpio_dt_spec in2;
    const struct gpio_dt_spec in3;
    const struct gpio_dt_spec in4;
    const struct  pwm_dt_spec enA;
    const struct  pwm_dt_spec enB;
} motors;

typedef struct
{
    char command;
    double pwm_data_left;
    double pwm_data_right;
    double yaw_controlled_pwm_right;
    double yaw_controlled_pwm_left;
    double yaw_angle;
    double ref_yaw;
    int left_enc_count;
    int right_enc_count;
    int16_t right_analog_ir;
    int distance;
    bool right_ir;
    bool front_ir;
    int front_ir_analog;
} feedback_t;

void init_motors(void);
void setMotorDirection(char direction);
void set_Speed(float m1_speed, float m2_speed, const motors *motors);
void motor_thread(void);
void turn_right();
```

## include/sensing.h
```c
#ifndef SENSING_H
#define SENSING_H

#include <stdint.h>
#include <stdbool.h>
#include "IR.h"
#include "encoders.h"
#include "accelerometer.h"

#define STACK_SIZE 2048
#define PRIORITY 7

extern struct k_msgq sensing_control_q;
extern struct k_timer read_sensor_timer;


typedef struct{
    ir_data_t ir_data;
    double encoder_data_left;
    double encoder_data_right;
    double yaw_angle;
    double ref_yaw;
    double yaw_controlled_pwm_right;
    double yaw_controlled_pwm_left;
    int left_enc_count;
    int right_enc_count;
    int dist;
    
 
} sensor_data_t;

void initSensors(void);
void readSensors(void);
void sensor_thread(void);

#endif // SENSING_H
```

## include/sensing_control_q.h
```c
// shared_mutex.h
#ifndef SENSING_CONTROL_Q_H
#define SENSING_CONTROL_Q_H

#include <zephyr/kernel.h>

extern struct k_msgq sensing_control_q;

#endif // SHARED_MUTEX_H
```

## include/shared_mutex.h
```c
// shared_mutex.h
#ifndef SHARED_MUTEX_H
#define SHARED_MUTEX_H

#include <zephyr/kernel.h>

extern struct k_mutex uart_mutex;

#endif // SHARED_MUTEX_H
```

## include/uart.h
```c
#ifndef UART_H
#define UART_H

#include <zephyr/kernel.h>
#include <zephyr/device.h>
#include <zephyr/drivers/uart.h>

extern struct k_mutex uart_mutex;

typedef struct {
    const struct device *uart_dev;
} uart_t;

void initUart(uart_t *uart);

#endif // UART_H
```
